## boards/shields/Kconfig.shield
```kconfig
# Copyright (c) 2020 Pete Johanson
# SPDX-License-Identifier: MIT

config SHIELD_KeyboardZMK_LEFT
    def_bool $(shields_list_contains,KeyboardZMK_left)

config SHIELD_KeyboardZMK_RIGHT
    def_bool $(shields_list_contains,KeyboardZMK_right)
```
